## main/Kconfig.projbuild
```kconfig
menu "BLE Signal Finder"

config FINDER_EMULATOR_BUILD
    bool "Simulator QA build with synthetic BLE reports"
    default n
    help
        Replace the NimBLE observer with a deterministic synthetic report
        source. Use only for PassportSim UI/interaction testing. Keep this
        disabled for release firmware.

endmenu
```

## sdkconfig.defaults
```kconfig
# FoloToy AI Passport — BLE Signal Finder
# ESP32-C3, 8 MB flash, no PSRAM.

CONFIG_IDF_TARGET="esp32c3"
CONFIG_ESPTOOLPY_FLASHSIZE_8MB=y
CONFIG_ESPTOOLPY_HEADER_FLASHSIZE_UPDATE=n

CONFIG_PARTITION_TABLE_CUSTOM=y
CONFIG_PARTITION_TABLE_CUSTOM_FILENAME="partitions.csv"
CONFIG_PARTITION_TABLE_FILENAME="partitions.csv"

CONFIG_ESP_CONSOLE_USB_SERIAL_JTAG=y
CONFIG_ESP_CONSOLE_SECONDARY_NONE=y

CONFIG_LV_COLOR_DEPTH_16=y
CONFIG_LV_DEF_REFR_PERIOD=20
CONFIG_LV_FONT_MONTSERRAT_14=n
CONFIG_LV_FONT_MONTSERRAT_20=n
CONFIG_LV_USE_CLIB_MALLOC=y
CONFIG_LV_TXT_ENC_UTF8=y
CONFIG_LV_USE_FONT_PLACEHOLDER=y

CONFIG_BT_ENABLED=y
CONFIG_BT_NIMBLE_ENABLED=y
CONFIG_BT_NIMBLE_ROLE_OBSERVER=y
CONFIG_BT_NIMBLE_ROLE_CENTRAL=n
CONFIG_BT_NIMBLE_ROLE_PERIPHERAL=n
CONFIG_BT_NIMBLE_ROLE_BROADCASTER=n
CONFIG_BT_NIMBLE_HOST_BASED_PRIVACY=n
CONFIG_BT_NIMBLE_NVS_PERSIST=n
CONFIG_BT_NIMBLE_MAX_CONNECTIONS=1

CONFIG_FREERTOS_HZ=1000

# Fixed application version keeps release firmware reproducible across commits.
CONFIG_APP_PROJECT_VER_FROM_CONFIG=y
CONFIG_APP_PROJECT_VER="1.0.0"
```
